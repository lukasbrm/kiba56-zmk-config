## boards/shields/kiba56/Kconfig.defconfig
```kconfig
if SHIELD_KIBA56_LEFT

config ZMK_KEYBOARD_NAME
    default "kiba56"

config ZMK_SPLIT_ROLE_CENTRAL
    default y

endif

if SHIELD_KIBA56_LEFT || SHIELD_KIBA56_RIGHT

config ZMK_SPLIT
    default y

if ZMK_DISPLAY

config I2C
    default y

config SSD1306
    default n

config SH1106
    default y

endif # ZMK_DISPLAY

if LVGL

config LV_Z_VDB_SIZE
    default 64

config LV_DPI_DEF
    default 148

config LV_Z_BITS_PER_PIXEL
    default 1

choice LV_COLOR_DEPTH
    default LV_COLOR_DEPTH_1
endchoice

endif # LVGL

endif
```

## boards/shields/kiba56/Kconfig.shield
```kconfig
config SHIELD_KIBA56_LEFT
    def_bool $(shields_list_contains,kiba56_left)

config SHIELD_KIBA56_RIGHT
    def_bool $(shields_list_contains,kiba56_right)
```
